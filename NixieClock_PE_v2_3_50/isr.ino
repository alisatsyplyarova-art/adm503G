#include "project_config.h"   // v2.3.34: настройки и распиновка (не зависит от порядка вкладок)
/* v2.3.34 — переработанное мультиплексирование (борьба с фантомными цифрами)
 *
 * Что изменено по сравнению с v2.3.33:
 *  1) Введён ГАРАНТИРОВАННЫЙ интервал гашения (MUX_BLANK_TICKS) в конце
 *     слота каждой лампы. Раньше пауза была равна (26 - indiDimm) тиков и
 *     при INDI_BRIGHT = 23..25 сжималась до 0..366 мкс — оптрон анода
 *     физически не успевал закрыться до смены кода на дешифраторе.
 *  2) Катод следующей лампы выставляется на MUX_SETUP_TICKS раньше, чем
 *     включается её анод (даёт катодным ключам/оптронам время устояться).
 *  3) Индекс digitMask[] защищён от значений > 9 (раньше был выход за
 *     границы массива и на лампе появлялась случайная цифра).
 *  4) indiDimm жёстко ограничивается сверху MUX_ON_MAX.
 *
 * v2.3.36 — исправлена регрессия v2.3.34/35 (фантомов стало БОЛЬШЕ):
 *  условие выключения анода было равенством (c == on), из-за чего при
 *  изменении яркости на лету (эффекты) момент выключения анода мог
 *  пропускаться до конца слота. Заменено на самовосстанавливающееся c >= on.
 *
 * v2.3.37 — УБРАНО ГАШЕНИЕ КАТОДОВ "ЗАПРЕЩЁННЫМ" КОДОМ ДЕШИФРАТОРА.
 *  Это была ошибочная идея v2.3.34, которая привела к массовым фантомам
 *  и срабатыванию защиты DC-DC ("уходит в защиту").
 *
 *  Почему код 0b1111 был опасен: К155ИД1/74141 гарантированно декодирует
 *  только входные коды 0..9. Поведение при кодах 10..15 ПРОИЗВОДИТЕЛЕМ НЕ
 *  ГАРАНТИРУЕТСЯ - на реальных экземплярах этих кодов К155ИД1 нередко
 *  ВКЛЮЧАЕТ СРАЗУ НЕСКОЛЬКО катодов одновременно вместо того, чтобы
 *  выключить все. Дополнительно в v2.3.34/35 условие "c == on" из-за бага
 *  посылало этот код на дешифратор почти НЕПРЕРЫВНО (см. v2.3.36), из-за
 *  чего несколько катодов оказывались одновременно под током через общий
 *  анод - резкий скачок тока просаживал анодное напряжение и включал
 *  программную защиту DC-DC (DCDCTick(), просадка HV при большом PWM).
 *
 *  Правильный и безопасный принцип (как было в оригинальном алгоритме
 *  AlexGyver и во всех версиях до 2.3.33): гасить ТОЛЬКО АНОД. Пока анод
 *  обесточен, ток через лампу не течёт вообще, независимо от того, какой
 *  код в этот момент висит на дешифраторе - поэтому дешифратор безопасно
 *  МОЖНО не трогать во время паузы. Гарантированная пауза (MUX_BLANK_TICKS)
 *  и самовосстанавливающееся сравнение (c >= on) из v2.3.34/36 сохранены -
 *  они помогают именно с задержкой закрытия оптрона анода и никак не
 *  связаны с багом дешифратора.
 */

// ===================== НАСТРОЙКА МУЛЬТИПЛЕКСИРОВАНИЯ =====================
// Один тик SQW = 1/8192 с = 122 мкс.
#define MUX_SLOT_TICKS   26                        // длительность слота лампы (26 * 122 мкс = 3.17 мс)
#define MUX_BLANK_TICKS   5                        // ГАРАНТИРОВАННАЯ пауза (анод выключен) в конце слота
                                                   // ↑ вот этот параметр и крутим, если фантомы остались: 4...8
#define MUX_SETUP_TICKS   1                        // за сколько тиков до включения анода выставить катод (1 = 122 мкс)
#define MUX_ON_MAX       (MUX_SLOT_TICKS - MUX_BLANK_TICKS)   // максимально допустимая яркость (21)

/* Выдача кода на дешифратор (разводка выводов как в оригинале).
 * v2.3.37: сюда передаются ТОЛЬКО валидные коды 0..9 (см. digitMask[]).
 * Запрещённые коды 10..15 больше нигде не используются.
 */
static inline void setDecoderCode(byte thisDig) {
  setPin(DECODER3, bitRead(thisDig, 0));
  setPin(DECODER1, bitRead(thisDig, 1));
  setPin(DECODER0, bitRead(thisDig, 2));
  setPin(DECODER2, bitRead(thisDig, 3));
}

/* Сколько тиков должна гореть лампа i (с ограничением сверху и по маске анодов) */
static inline int8_t muxOnTicks(int8_t i) {
  if (!(anodeStates & (1 << i))) return 0;         // лампа погашена маской
  int8_t d = indiDimm[i];
  if (d <= 0) return 0;
  if (d > MUX_ON_MAX) d = MUX_ON_MAX;
  return d;
}

/* Обработчик прерывания SQW
 *  Входные параметры: нет
 *  Выходные параметры: нет
 */
void RTC_handler() {
  // v2.3.31: этот счётчик не участвует в расчёте времени, он только
  // позволяет loop() определить, что SQW от DS3231 перестал приходить.
  ++sqwEdgeCounter;

  // таймер
  if (++SQW_counter == 4096) halfsecond = true;  // Прошло полсекунды
  else if (SQW_counter == 8192) {     // Прошла секунда
    SQW_counter = 0;                  // Начинаем новую секунду
    halfsecond = true;                // Полсекундный индикатор
  }

  // бипер (замена tone() по причине перенастройки базовых таймеров для его работы)
  if (note_ip) {                      // будильник включен
    if (note_up_low) {                // положительная полуволна
      if (++note_count >= NotePrescalerHigh[note_num]) {
                                      // достигли длительности положительной полуволны
        note_up_low = false;          // переходим на отрицательную полуволну
        note_count = 0;               // сбрасываем счётчик
        bitWrite(PORTD, PIEZO, 0);    // переводим порт в низкое состояние
      }
    } else {                          // отрицательная полуволна
      if (++note_count >= NotePrescalerLow[note_num]) {
                                      // достигли длительности отрицательной полуволны
        note_count = 0;               // сбрасываем счётчик
        if (NotePrescalerHigh[note_num]) {
                                      // при ненулевой длительности положительной полуволны
          note_up_low = true;         // переходим на положительную полуволну
          bitWrite(PORTD, PIEZO, 1);  // переводим порт в высокое состояние
        }
      }
    }
  }

  // ============ мультиплексирование ламп ============
  int8_t c  = ++indiCounter[curIndi];              // тик внутри слота текущей лампы
  int8_t on = muxOnTicks(curIndi);                 // сколько тиков она должна гореть

  // --- 1. Конец свечения: гасим ТОЛЬКО анод ---
  // v2.3.37: дешифратор здесь НЕ трогаем. Пока анод обесточен, ток через
  // лампу не течёт независимо от кода на дешифраторе - трогать его лишний
  // раз незачем и, как показала практика v2.3.34/36, опасно.
  // v2.3.36: самовосстанавливающееся сравнение (>=), а не равенство - если
  // on уменьшился ниже уже пройденного c (эффекты меняют яркость на лету),
  // выключение анода происходит немедленно на следующем тике, а не
  // пропускается до конца слота.
  if (c >= on) {
    setPin(opts[curIndi], 0);                      // анод выключен
  }

  // --- 2. Заранее выставляем катод следующей лампы ---
  // К этому моменту (тик 25 из 26) её собственный анод уже гарантированно
  // выключен (MUX_BLANK_TICKS = 5 тиков паузы), поэтому можно спокойно
  // менять код на дешифраторе - на анод СЕЙЧАС ток всё равно не подаётся.
  if (c == MUX_SLOT_TICKS - MUX_SETUP_TICKS) {
    int8_t n = curIndi + 1;
    if (n >= NUMTUB) n = 0;
    if (muxOnTicks(n) > 0) {
      int8_t dg = indiDigits[n];
      if (dg >= 0 && dg <= 9) setDecoderCode(digitMask[dg]);
      // защита от выхода за массив: при некорректном dg код дешифратора
      // просто НЕ обновляется (остаётся прежнее валидное значение) -
      // никогда не посылаем decoder код вне диапазона 0..9.
    }
  }

  // --- 3. Смена лампы: катод уже устоялся, включаем анод ---
  if (c >= MUX_SLOT_TICKS) {
    indiCounter[curIndi] = 0;                      // сброс счетчика лампы
    if (++curIndi >= NUMTUB) curIndi = 0;          // смена лампы закольцованная
    if (muxOnTicks(curIndi) > 0) setPin(opts[curIndi], 1);
  }
}
